## config/west.yml
```yaml
manifest:
  remotes:
    - name: zmkfirmware
      url-base: https://github.com/zmkfirmware
    - name: urob
      url-base: https://github.com/urob
    - name: mctechnology17
      url-base: https://github.com/mctechnology17
    - name: mentaldesk
      url-base: https://github.com/mentaldesk
    - name: cormoran
      url-base: https://github.com/cormoran
      
  projects:
    - name: zmk-leader-key
      remote: urob
      revision: v0.3 # Should match ZMK release.
    - name: zmk-adaptive-key
      remote: urob
      revision: v0.3 # Should match ZMK release.
    # support nice_oled and nice_epaper
    - name: zmk-nice-oled
      remote: mctechnology17
      revision: main
    - name: oskey
      remote: mentaldesk
      revision: v0.3.0
    - name: zmk
      remote: zmkfirmware
      revision: v0.3
      import:
        file: app/west.yml
  self:
    path: config
```
